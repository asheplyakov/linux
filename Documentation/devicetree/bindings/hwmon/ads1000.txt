## drivers/net/ethernet/baikal/Kconfig
```kconfig
#
# AMD network device configuration
#

config NET_VENDOR_BAIKAL
	bool "Baikal Electronics SoC"
	default y
	depends on MIPS_BAIKAL || ARM64_BAIKAL || ARM64 || MIPS
	---help---
	  If you have a Baikal Electronics SoC with network (Ethernet)
	  controller say Y.

	  Note that the answer to this question does not directly affect
	  the kernel: saying N will just case the configurator to skip all
	  the questions regarding Baikal SoCs. If you say Y, you will be asked
	  for your specific driver in the following questions.

if NET_VENDOR_BAIKAL

config BAIKAL_XGBE
	tristate "Baikal 10GbE Ethernet driver"
	depends on OF_NET && HAS_IOMEM
	select PHYLIB
	select BITREVERSE
	select CRC32
	select PTP_1588_CLOCK
	---help---
	  This driver supports the Baikal 10GbE Ethernet device found on an
	  Baikal SoC.

	  To compile this driver as a module, choose M here: the module
	  will be called baikal-xgbe.

endif # NET_VENDOR_BAIKAL
```

## drivers/staging/sm750fb/Kconfig
```kconfig
config FB_SM750
	tristate "Silicon Motion SM750 framebuffer support"
	depends on FB && PCI
	select FB_MODE_HELPERS
	select FB_CFB_FILLRECT
	select FB_CFB_COPYAREA
	select FB_CFB_IMAGEBLIT
	select BACKLIGHT_LCD_SUPPORT
	select BACKLIGHT_CLASS_DEVICE
	select I2C_ALGOBIT
	help
	  Frame buffer driver for the Silicon Motion SM750 chip
	  with 2D accelearion and dual head support.

	  This driver is also available as a module. The module will be
	  called sm750fb. If you want to compile it as a module, say M
	  here and read <file:Documentation/kbuild/modules.txt>.

config SM750_DMA
	bool "Enable PCIe DMA for SM750"
	depends on FB_SM750 && BAIKAL_EDMA
```

## drivers/staging/smifb/Kconfig
```kconfig
config DRM_SMIFB
	tristate "Silicon Motion sm750/sm768 DRM support"
	depends on DRM
	depends on PCI
	select DRM_TTM
	select DRM_KMS_HELPER
	select DRM_KMS_FB_HELPER
	select FB_SYS_FILLRECT
	select FB_SYS_COPYAREA
	select FB_SYS_IMAGEBLIT
	help
	  Choose this option if you have a system with SiliconMotion
	  sm750 or sm768 Graphics.

if DRM_SMIFB

comment "Additional sm750/sm768 features"

config DRM_SMIFB_EDMA
	bool "Use DMA for transfers from RAM to FB"
	depends on BAIKAL_EDMA
	default y if MIPS_BAIKAL

config DRM_SMIFB_SII9022_HDMI
	bool "Enable SII9022 HDMI transmitter support for sm750"
	default n
	help
	  This option updates the smifb driver to support the SII9022 HDMI
	  transmitter together with sm750 chip.

	  Say N, unless you are using a device with one.

config DRM_SMIFB_I2S_UDA1345_AUDIO
	bool "Enable i2s-audio interace for sm768 with uda1345 codec"
	default n
	help
	  This option updates the sm768 i2s-interface to access uda1345 codec
	  installed on the target device.

	  Say N, unless you are using a device with one.

config DRM_SMIFB_PRIME
	bool "Enable DRM PRIMT config"
	default n
	help
	  PRIME is the cross device buffer sharing framework in drm. To userspace
	  PRIME buffers are dma-buf based file descriptors.
	  
	  If unsure say N.

endif
```
