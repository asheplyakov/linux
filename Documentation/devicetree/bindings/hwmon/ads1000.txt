## arch/arm64/configs/baikal_defconfig
```kconfig
#
# Linux/arm64 4.9.xx Kernel Configuration (defconfig)
# for Baikal-M SOC (test version, unsorted)
#
CONFIG_IOMMU_DMA=y
CONFIG_ARM64_VA_BITS_48=y
CONFIG_LOCALVERSION="b-m-20171215"
CONFIG_DEFAULT_HOSTNAME="bm"
CONFIG_SYSVIPC=y
CONFIG_POSIX_MQUEUE=y
CONFIG_AUDIT=y
CONFIG_NO_HZ_IDLE=y
CONFIG_HIGH_RES_TIMERS=y
CONFIG_BSD_PROCESS_ACCT=y
CONFIG_BSD_PROCESS_ACCT_V3=y
CONFIG_TASKSTATS=y
CONFIG_TASK_DELAY_ACCT=y
CONFIG_TASK_XACCT=y
CONFIG_TASK_IO_ACCOUNTING=y
CONFIG_IKCONFIG=y
CONFIG_IKCONFIG_PROC=y
CONFIG_MEMCG=y
CONFIG_MEMCG_SWAP=y
CONFIG_BLK_CGROUP=y
CONFIG_CFS_BANDWIDTH=y
CONFIG_CGROUP_PIDS=y
CONFIG_CGROUP_HUGETLB=y
CONFIG_CPUSETS=y
CONFIG_CGROUP_DEVICE=y
CONFIG_CGROUP_CPUACCT=y
CONFIG_CGROUP_PERF=y
CONFIG_NAMESPACES=y
CONFIG_USER_NS=y
CONFIG_SCHED_AUTOGROUP=y
CONFIG_BLK_DEV_INITRD=y
CONFIG_KALLSYMS_ALL=y
CONFIG_EXPERT=y
CONFIG_BPF_SYSCALL=y
CONFIG_USERFAULTFD=y
CONFIG_PERF_EVENTS=y
CONFIG_SLAB=y
CONFIG_CC_STACKPROTECTOR_STRONG=y
CONFIG_MODULES=y
CONFIG_MODULE_FORCE_LOAD=y
CONFIG_MODULE_UNLOAD=y
CONFIG_MODULE_FORCE_UNLOAD=y
CONFIG_MODVERSIONS=y
CONFIG_PARTITION_ADVANCED=y
CONFIG_CFQ_GROUP_IOSCHED=y
CONFIG_ARCH_BAIKAL=y
CONFIG_SCHED_MC=y
CONFIG_NR_CPUS=8
CONFIG_HOTPLUG_CPU=y
CONFIG_PREEMPT_VOLUNTARY=y
CONFIG_HZ_1000=y
CONFIG_HZ=1000
CONFIG_KSM=y
CONFIG_TRANSPARENT_HUGEPAGE=y
CONFIG_TRANSPARENT_HUGEPAGE_MADVISE=y
CONFIG_FRONTSWAP=y
CONFIG_CMA=y
CONFIG_COMPAT=y
CONFIG_NET=y
CONFIG_PACKET=y
CONFIG_PACKET_DIAG=y
CONFIG_UNIX=y
CONFIG_INET=y
CONFIG_DEVTMPFS=y
CONFIG_UEVENT_HELPER=y
CONFIG_DMA_CMA=y
CONFIG_CMA_SIZE_MBYTES=256
CONFIG_DMA_SHARED_BUFFER_USES_KDS=y
CONFIG_BLK_DEV_LOOP=y
CONFIG_BLK_DEV_NBD=y
CONFIG_BLK_DEV_RAM=y
CONFIG_BLK_DEV_RAM_SIZE=16384
CONFIG_EEPROM_AT25=m
CONFIG_NETDEVICES=y
CONFIG_BONDING=y
CONFIG_DUMMY=y
CONFIG_SYNOPSYS_DWC_ETH_QOS=y
CONFIG_REALTEK_PHY=m
CONFIG_VT_HW_CONSOLE_BINDING=y
CONFIG_SERIAL_8250=y
CONFIG_SERIAL_8250_EXTENDED=y
CONFIG_SERIAL_8250_CONSOLE=y
CONFIG_SERIAL_8250_NR_UARTS=2
CONFIG_SERIAL_8250_RUNTIME_UARTS=2
CONFIG_SERIAL_8250_DW=y
#CONFIG_SERIAL_8250_PNP=y
#CONFIG_SERIAL_8250_SHARE_IRQ=y
CONFIG_SERIAL_OF_PLATFORM=y
CONFIG_SERIAL_CORE=y
CONFIG_SERIAL_CORE_CONSOLE=y
CONFIG_TTY_PRINTK=y
CONFIG_SPI=y
CONFIG_RTC_CLASS=y
CONFIG_DMADEVICES=y
CONFIG_SYNC_FILE=y
CONFIG_COMMON_CLK_VERSATILE=y
CONFIG_MAILBOX=y
CONFIG_ARM_MHU=m
CONFIG_ARM_SMMU=y
CONFIG_ARM_SMMU_V3=y
CONFIG_EXT4_FS=y
CONFIG_EXT4_FS_POSIX_ACL=y
CONFIG_XFS_FS=y
CONFIG_XFS_QUOTA=y
CONFIG_XFS_POSIX_ACL=y
CONFIG_BTRFS_FS=m
CONFIG_BTRFS_FS_POSIX_ACL=y
CONFIG_EXT4_FS_SECURITY=y
CONFIG_EXT4_ENCRYPTION=y
CONFIG_EXPORTFS_BLOCK_OPS=y
CONFIG_FANOTIFY=y
CONFIG_AUTOFS4_FS=y
CONFIG_FSCACHE=y
CONFIG_FSCACHE_STATS=y
CONFIG_CACHEFILES=y
CONFIG_ISO9660_FS=y
CONFIG_MSDOS_FS=y
CONFIG_VFAT_FS=y
CONFIG_FAT_DEFAULT_IOCHARSET="ascii"
CONFIG_FAT_DEFAULT_UTF8=y
CONFIG_NTFS_FS=m
CONFIG_PROC_KCORE=y
CONFIG_PROC_CHILDREN=y
CONFIG_TMPFS=y
CONFIG_TMPFS_POSIX_ACL=y
CONFIG_HUGETLBFS=y
CONFIG_CONFIGFS_FS=y
CONFIG_EFIVAR_FS=y
CONFIG_SQUASHFS=y
CONFIG_PSTORE=y
CONFIG_NFS_FS=y
CONFIG_NFS_V3_ACL=y
CONFIG_NFS_V4=y
CONFIG_NFS_SWAP=y
CONFIG_NFS_V4_1=y
CONFIG_NFS_V4_2=y
CONFIG_NFS_V4_1_IMPLEMENTATION_ID_DOMAIN="y"
CONFIG_NFS_V4_1_MIGRATION=y
CONFIG_NFSD=y
CONFIG_NFSD_V3_ACL=y
CONFIG_NFSD_V4=y
CONFIG_NFSD_BLOCKLAYOUT=y
CONFIG_NFSD_SCSILAYOUT=y
CONFIG_NFSD_FAULT_INJECTION=y
CONFIG_SUNRPC_DEBUG=y
CONFIG_NLS_CODEPAGE_437=y
CONFIG_NLS_CODEPAGE_852=y
CONFIG_NLS_CODEPAGE_866=y
CONFIG_NLS_CODEPAGE_1251=y
CONFIG_NLS_ASCII=y
CONFIG_NLS_ISO8859_1=y
CONFIG_NLS_ISO8859_5=y
CONFIG_NLS_KOI8_R=y
CONFIG_NLS_UTF8=y
CONFIG_PRINTK_TIME=y
CONFIG_BOOT_PRINTK_DELAY=y
CONFIG_DYNAMIC_DEBUG=y
CONFIG_DEBUG_INFO=y
CONFIG_GDB_SCRIPTS=y
CONFIG_STRIP_ASM_SYMS=y
CONFIG_MAGIC_SYSRQ=y
CONFIG_MAGIC_SYSRQ_DEFAULT_ENABLE=0x01b6
CONFIG_PAGE_POISONING=y
CONFIG_PAGE_POISONING_NO_SANITY=y
CONFIG_DEBUG_MEMORY_INIT=y
CONFIG_LOCKUP_DETECTOR=y
CONFIG_SCHEDSTATS=y
CONFIG_SCHED_STACK_END_CHECK=y
CONFIG_DEBUG_LIST=y
CONFIG_NOTIFIER_ERROR_INJECTION=m
CONFIG_FTRACE_SYSCALLS=y
CONFIG_TRACER_SNAPSHOT=y
CONFIG_STACK_TRACER=y
CONFIG_BLK_DEV_IO_TRACE=y
CONFIG_TEST_USER_COPY=m
CONFIG_TEST_BPF=m
CONFIG_TEST_FIRMWARE=m
CONFIG_TEST_STATIC_KEYS=m
CONFIG_STRICT_DEVMEM=y
CONFIG_IO_STRICT_DEVMEM=y
CONFIG_CRYPTO_MD5=y
CONFIG_CRYPTO_LZO=y
CONFIG_CRYPTO_LZ4=m
CONFIG_CRYPTO_LZ4HC=m
CONFIG_CRYPTO_ANSI_CPRNG=m
CONFIG_CRYPTO_USER_API_HASH=m
CONFIG_CRYPTO_USER_API_SKCIPHER=m
CONFIG_CRYPTO_USER_API_AEAD=m
CONFIG_ARM64_CRYPTO=n
CONFIG_CRYPTO_SHA1_ARM64_CE=n
CONFIG_CRYPTO_SHA2_ARM64_CE=n
CONFIG_CRYPTO_GHASH_ARM64_CE=n
CONFIG_CRYPTO_AES_ARM64_CE_CCM=n
CONFIG_CRYPTO_AES_ARM64_CE_BLK=n
CONFIG_CRYPTO_CRC32_ARM64=n
CONFIG_LIBCRC32C=m
CONFIG_IRQ_POLL=y

CONFIG_EFI=y
CONFIG_EFI_STUB=y
CONFIG_RELOCATABLE=y

CONFIG_EFI_EARLYCON=y
CONFIG_FB=y
CONFIG_FB_EFI=y
CONFIG_FRAMEBUFFER_CONSOLE=y

CONFIG_DRM=y
CONFIG_DRM_BAIKAL_VDU=y
CONFIG_DRM_BAIKAL_HDMI=y
CONFIG_DRM_DW_HDMI_AHB_AUDIO=m
CONFIG_FB_MODE_HELPERS=y

CONFIG_DRM_BE_VDU=m
CONFIG_DMA_SHARED_BUFFERS_USES_KDS=y

CONFIG_DRM_PANEL_LVDS=y
CONFIG_LOGO=y
CONFIG_FRAMEBUFFER_CONSOLE=y
CONFIG_BACKLIGHT_LCD_SUPPORT=y
CONFIG_BACKLIGHT_CLASS_DEVICE=y

CONFIG_MSDOS_PARTITION=y
CONFIG_EFI_PARTITION=y

CONFIG_BLK_DEV_SD=y
CONFIG_CHR_DEV_SG=y
CONFIG_SCSI=y
CONFIG_SCSI_DMA=y
CONFIG_SCSI_PROC_FS=y
CONFIG_SCSI_CONSTANTS=y
CONFIG_SCSI_LOGGING=y
CONFIG_SCSI_SCAN_ASYNC=y
CONFIG_SCSI_MOD=y
CONFIG_SCSI_LOWLEVEL=y

CONFIG_ATA=y
CONFIG_ATA_VERBOSE_ERROR=y
CONFIG_SATA_AHCI_PLATFORM=y
CONFIG_SATA_PMP=y
CONFIG_ATA_SFF=y
CONFIG_ATA_BMDMA=y

CONFIG_I2C=y
CONFIG_I2C_CHARDEV=y
CONFIG_I2C_BOARDINFO=y
CONFIG_I2C_COMPAT=y
CONFIG_I2C_HELPER_AUTO=y
CONFIG_I2C_DESIGNWARE_CORE=y
CONFIG_I2C_DESIGNWARE_PLATFORM=y
CONFIG_EEPROM_AT24=y
CONFIG_EEPROM_AT25=y

CONFIG_WATCHDOG=y
CONFIG_WATCHDOG_CORE=y
CONFIG_WATCHDOG_NOWAYOUT=y
CONFIG_DW_WATCHDOG=y

CONFIG_GENERIC_CLOCKEVENTS=y
CONFIG_TIMER_STATS=y
CONFIG_DW_APB_TIMER=y
CONFIG_DW_APB_TIMER_OF=y

CONFIG_HWMON=y
CONFIG_THERMAL=y
CONFIG_THERMAL_HWMON=y
CONFIG_THERMAL_OF=y

CONFIG_MII=y
CONFIG_NET_CORE=y
CONFIG_ETHERNET=y
CONFIG_NET_VENDOR_STMICRO=y
CONFIG_STMMAC_ETH=y
CONFIG_STMMAC_PLATFORM=y
CONFIG_DWMAC_BAIKAL=y
CONFIG_CONFIG_PHYLIB=y
CONFIG_DW_XGBE_PHY=y
CONFIG_MARVELL_PHY=y
CONFIG_MICREL_PHY=y

CONFIG_SPI=y
CONFIG_SPI_MASTER=y
CONFIG_SPI_BAIKAL=y
CONFIG_SPI_DESIGNWARE=y
CONFIG_SPI_DW_MMIO=y
CONFIG_SPI_SPIDEV=y
CONFIG_SPI_DEBUG=y
CONFIG_SPI_DIGITALBLOCK_ESPI=y
CONFIG_EFI_VARS=y

CONFIG_MTD=y
CONFIG_MTD_CMDLINE_PARTS=y
CONFIG_MTD_OF_PARTS=y
CONFIG_MTD_BLKDEVS=y
CONFIG_MTD_BLOCK=y
CONFIG_MTD_JEDECPROBE=y
CONFIG_MTD_GEN_PROBE=y
CONFIG_MTD_MAP_BANK_WIDTH_1=y
CONFIG_MTD_MAP_BANK_WIDTH_2=y
CONFIG_MTD_MAP_BANK_WIDTH_4=y
CONFIG_MTD_CFI_I1=y
CONFIG_MTD_CFI_I2=y
CONFIG_MTD_M25P80=y
CONFIG_MTD_BLOCK2MTD=y
CONFIG_MTD_SPI_NOR=y
CONFIG_MTD_SPI_NOR_USE_4K_SECTORS=y

CONFIG_ARCH_HAVE_CUSTOM_GPIO_H=y
CONFIG_ARCH_WANT_OPTIONAL_GPIOLIB=y
CONFIG_GPIOLIB=y
CONFIG_GPIO_DEVRES=y
CONFIG_OF_GPIO=y
CONFIG_DEBUG_GPIO=y
CONFIG_GPIO_SYSFS=y
CONFIG_GPIO_GENERIC=y
CONFIG_GPIO_GENERIC_PLATFORM=y
CONFIG_GPIO_PCF857X=y
CONFIG_GPIO_DWAPB=y
CONFIG_MDIO_GPIO=y

CONFIG_RTC_LIB=y
CONFIG_RTC_CLASS=y
CONFIG_RTC_HCTOSYS=y
CONFIG_RTC_SYSTOHC=y
CONFIG_RTC_HCTOSYS_DEVICE="rtc0"
CONFIG_RTC_INTF_SYSFS=y
CONFIG_RTC_INTF_PROC=y
CONFIG_RTC_INTF_DEV=y
CONFIG_RTC_DRV_DS1307=y
CONFIG_RTC_DRV_DW=y

CONFIG_SOUND=y
CONFIG_SND=y
CONFIG_SND_SOC=y
CONFIG_CLKDEV_LOOKUP=y
CONFIG_SND_DESIGNWARE_I2S=y
CONFIG_SND_DESIGNWARE_PCM=y
CONFIG_SND_SOC_TLV320AIC3X=y

CONFIG_INPUT_EVDEV=y
CONFIG_USB=y
CONFIG_USB_ANNOUNCE_NEW_DEVICES=y
CONFIG_USB_DYNAMIC_MINORS=y
CONFIG_USB_ULPI_BUS=y
CONFIG_USB_MON=y
CONFIG_USB_XHCI_HCD=y
CONFIG_USB_EHCI_HCD=m
CONFIG_USB_EHCI_ROOT_HUB_TT=y
CONFIG_USB_EHCI_HCD_PLATFORM=m
CONFIG_USB_OHCI_HCD=y
CONFIG_USB_OHCI_HCD_PLATFORM=m
CONFIG_USB_HCD_TEST_MODE=y
CONFIG_USB_STORAGE=y
CONFIG_USB_UAS=y
CONFIG_USB_DWC3=y
CONFIG_USB_DWC3_BAIKAL=y
CONFIG_USB_DWC3_ULPI=y
CONFIG_USB_PHY=y
CONFIG_USB_ULPI=y

CONFIG_SUSPEND=n
CONFIG_DEBUG_INFO=y
CONFIG_DEBUG_KERNEL=y
CONFIG_DYNAMIC_DEBUG=y

CONFIG_PCI=y
CONFIG_PCI_BAIKAL=y
CONFIG_PCI_DEBUG=y

CONFIG_E1000=m
CONFIG_E1000E=m
CONFIG_IGB=m

CONFIG_DRM_TTM=y
CONFIG_DRM_RADEON=m

CONFIG_NVMEM=y
CONFIG_BLK_DEV_NVME=m

CONFIG_DRM_NOUVEAU=m

CONFIG_NET_VENDOR_AMD=y
CONFIG_AMD_XGBE=y
CONFIG_BAIKAL_MDIO=y
CONFIG_88X2222_PHY=y
CONFIG_MDIO_BITBANG=y

CONFIG_TP_BMC=y
```

## arch/mips/baikal/Kconfig
```kconfig
#
# Baikal-T/T1 SOC platform support code.
#
# Copyright (C) 2014-2017 Baikal Electronics JSC
#
# Authors:
# Dmitry Dunaev <dmitry.dunaev@baikalelectronics.com>
# Alexander Sazonov <Alexander.Sazonov@baikalelectronics.ru>
#
# This program is free software; you can redistribute it and/or
# modify it under the terms of the GNU General Public License
# as published by the Free Software Foundation; either version 2
# of the License, or (at your option) any later version.
#
# This program is distributed in the hope that it will be useful,
# but WITHOUT ANY WARRANTY; without even the implied warranty of
# MERCHANTABILITY or FITNESS FOR A PARTICULAR PURPOSE.  See the
# GNU General Public License for more details.
#
# You should have received a copy of the GNU General Public License
# along with this program; if not, write to the Free Software
# Foundation, Inc., 51 Franklin Street, Fifth Floor, Boston, MA  02110-1301, USA.
#

if MIPS_BAIKAL

choice
    prompt "Baikal-T SoC Family Support"
    default MIPS_BAIKAL_T  if MACH_BAIKAL_BFK
    default MIPS_BAIKAL_T1 if MACH_BAIKAL_BFK3
    default MIPS_BAIKAL_T1

config MIPS_BAIKAL_T
    bool "BAIKAL-T MIPS CPU"
    select OF_EARLY_FLATTREE
    select GENERIC_SCHED_CLOCK
    select NO_IOPORT
    select SOC_BUS
    help
      Baikal-T SoC with MIPS32 P5600 core (engineering version)

config MIPS_BAIKAL_T1
    bool "BAIKAL-T1 MIPS CPU"
    select OF_EARLY_FLATTREE
    select GENERIC_SCHED_CLOCK
    select NO_IOPORT
    select SOC_BUS
    select BAIKAL_EFUSE
    help
      Baikal-T1 SoC with MIPS32 P5600 core (production version)

endchoice

config BAIKAL_T_COMMON
    bool "Baikal-T SoC common features"

    # Boot Controller support
    select BE_BC

    # Hardware features
    select HW_HAS_PCI
    select HW_PERF_EVENTS
    select CPU_FREQ_GOV_PERFORMANCE
    select CPU_FREQ_GOV_POWERSAVE

    # Common
    select PHYLIB
    select DEBUG_LL
    select TIMER_GENERIC
    select ARCH_WANT_OPTIONAL_GPIOLIB
    select SYS_HAS_CPU_MIPS32_R5
    select GENERIC_CLOCKEVENTS_MIN_ADJUST

    # HW perfomance counters
    select HAVE_PERF_EVENTS
    select PERF_EVENTS
    select HW_PERF_EVENTS

    # Clock source
    select COMMON_CLK_BAIKAL
    select WDT_MIPS_GIC

    # Serial UART
    select SERIAL_8250
    select SERIAL_8250_CONSOLE
    select SERIAL_8250_EXTENDED
    select SERIAL_8250_DW

    # WatchDog
    select DW_WATCHDOG

    # Timers
    select CLKSRC_OF
    select DW_APB_TIMER
    select DW_APB_TIMER_OF

    # I2C Bus support
    select I2C_DESIGNWARE_CORE
    select I2C_DESIGNWARE_PLATFORM

    # GPIO support
    select GPIOLIB
    select OF_GPIO
    select GPIO_SYSFS
    select GPIO_DWAPB
    select GPIO_GENERIC

    # Gigabit Ethernet support
    select STMMAC_ETH
    select STMMAC_PLATFORM
    select STMMAC_DEBUG_FS

    # SPI bus support
    select SPI_DESIGNWARE
    select SPI_DW_MMIO
    select SPI_BAIKAL

    # USB Support
    select USB_DWC3
    select USB_DWC3_HOST
    select USB_DWC3_BAIKAL
    select USB_PHY

    help
      Common features of Baikal-T SoC based boards

choice
    prompt "Baikal-T SoC based Boards"
    default MACH_BAIKAL_BFK

config MACH_BAIKAL_BFK
    bool "Baikal-T BFK board"

    # Basic SoC features
    select MIPS_BAIKAL_T
    select BAIKAL_T_COMMON

    # Memory mapping granularity
    select PAGE_SIZE_16KB

    # DTB select
    select DTB_BAIKAL_BFK

config MACH_BAIKAL_BFK3
    bool "Baikal-T1 BFK3 board"

    # Basic SoC features
    select MIPS_BAIKAL_T1
    select BAIKAL_T_COMMON

    # Memory mapping granularity
    select PAGE_SIZE_16KB

    # DTB select
    select DTB_BAIKAL_BFK3

    # MMC
    select MMC
    select MMC_SPI


endchoice

choice
    prompt "Baikal-T based Board Configs"
    default DTB_BAIKAL_BFK
    help
      Select device tree for Baikal-T/T1 SoC based board

config DTB_BAIKAL_BFK
    bool "Baikal-T BFK board"
    help
      Device tree for BFK boards (for versions 1.0, 1.5, 1.6)
      based on Baikal-T SOC.

config DTB_BAIKAL_BFK3
    bool "Baikal-T1 BFK3 board"
    help
      Device tree for BFK3 boards (for versions 2.0, 3.x)
      based on Baikal-T1 SOC.

config DTB_BAIKAL_BFKX
    bool "Baikal-T1 BFKX board"
    help
      Device tree for BFKX boards (for version BFK1.6+Baikal-T1)
      based on Baikal-T1 SOC.

endchoice

config ARCH_NR_GPIOS
    int "Baikal GPIOs plus architecture specific ones"
    range 32 512
    default 43 if MACH_BAIKAL_BFK
    default 43 if MACH_BAIKAL_BFK3
    default 35
    help
      Maximum number of GPIOs in the system.

      If unsure, leave the default value.

menuconfig BAIKAL_ERRATA
    bool "Baikal-T SoC Errata Fix"
    help
      Select this option if you want to fix known Baikal Errata

if BAIKAL_ERRATA

config BAIKAL_ERRATA_XGMAC
    bool "Fix for MMD Devices in package registers swap in XGMAC"
    help
      Fix for MMD Devices in package registers swap in XGMAC in
      early Baikal-T SoCs

      If unsure, say Y.

config BAIKAL_ERRATA_GMAC
    bool "Fix for GMAC block speed 10/100M"
    help
      Fix for GMAC block speed 10/100M in early Baikal-T SoCs

      If unsure, say N.

config BAIKAL_ERRATA_GBE_PHY_MICREL
    bool "Fix for Micrel PHY RX delay on BFK board"
    help
      Fix for Micrel PHY RX delay on early revisions of BFK board (v1.0)

      If unsure, say N.

endif # BAIKAL_ERRATA
endif # MIPS_BAIKAL

config SYS_HAS_CPU_MIPS32_R5
    bool
    default n

config WDT_MIPS_GIC
    bool
    default n

config BE_BC
    tristate "boot controller"

config BAIKAL_EFUSE
    tristate "Baikal-T1 eFUSE driver"

# source "drivers/dma/baikal/Kconfig"
```
