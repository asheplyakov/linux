/*
 * Baikal-T1 MRBT1 board device tree
 *
 * Copyright (C) 2018 T-platforms JSC
 *
 * This program is free software; you can redistribute it and/or
 * modify it under the terms of the GNU General Public License
 * as published by the Free Software Foundation; either version 2
 * of the License, or (at your option) any later version.
 */

/dts-v1/;

#include "tplatforms_mrbt1.dtsi"
