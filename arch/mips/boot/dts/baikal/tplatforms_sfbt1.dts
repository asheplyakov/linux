/*
 * Baikal-T SFBT1 card device tree
 *
 * Copyright (C) 2016-2018 T-platforms JSC
 *
 * This program is free software; you can redistribute it and/or
 * modify it under the terms of the GNU General Public License
 * as published by the Free Software Foundation; either version 2
 * of the License, or (at your option) any later version.
 */

/dts-v1/;

#include "tplatforms_sfbt1.dtsi"
