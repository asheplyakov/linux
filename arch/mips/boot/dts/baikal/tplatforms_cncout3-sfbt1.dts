/*
 * Baikal-T CNC OUT v3 SFBT1 board device tree
 *
 * Copyright (C) 2018 T-platforms JSC
 *
 * This program is free software; you can redistribute it and/or
 * modify it under the terms of the GNU General Public License
 * as published by the Free Software Foundation; either version 2
 * of the License, or (at your option) any later version.
 */

/dts-v1/;

#include "tplatforms_sfbt1.dtsi"
#include "tplatforms_cncout3.dtsi"

/ {
	model = "Baikal-T CNC OUT v3 SFBT1 Board";
	compatible = "baikal,mips", "baikal,baikal-t-soc", "tplatforms,baikal-sfbt1-card", "tplatforms,baikal-cncout3-sfbt1-board";
};
