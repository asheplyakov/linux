/*
 * Baikal-T Axitech v1 SFBT1 board device tree
 *
 * Copyright (C) 2017-2018 T-platforms JSC
 *
 * This program is free software; you can redistribute it and/or
 * modify it under the terms of the GNU General Public License
 * as published by the Free Software Foundation; either version 2
 * of the License, or (at your option) any later version.
 */

/dts-v1/;

#include "tplatforms_sfbt1.dtsi"
#include "tplatforms_axt1.dtsi"

/ {
	model = "Baikal-T Axitech v1 SFBT1 Board";
	compatible = "baikal,mips", "baikal,baikal-t-soc", "tplatforms,baikal-sfbt1-card", "tplatforms,baikal-axt1-sfbt1-board";
};
